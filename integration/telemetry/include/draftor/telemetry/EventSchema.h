// Generated by scripts/generate_schema.py; edit schema/events.json.
#pragma once
#include <cstdint>
namespace draftor::telemetry {
enum class WritingMode : std::uint8_t { Unknown = 0, Horizontal = 1, VerticalRL = 2 };
constexpr bool valid_WritingMode(std::uint8_t value) noexcept {
    switch (value) {
    case 0:
    case 1:
    case 2:
        return true;
    default: return false;
    }
}
enum class BaseInputMode : std::uint8_t { Unknown = 0, Chinese = 1, English = 2 };
constexpr bool valid_BaseInputMode(std::uint8_t value) noexcept {
    switch (value) {
    case 0:
    case 1:
    case 2:
        return true;
    default: return false;
    }
}
enum class EditContext : std::uint8_t { Unknown = 0, Document = 1, Composition = 2, Find = 3, Candidate = 4, Literal = 5 };
constexpr bool valid_EditContext(std::uint8_t value) noexcept {
    switch (value) {
    case 0:
    case 1:
    case 2:
    case 3:
    case 4:
    case 5:
        return true;
    default: return false;
    }
}
enum class PhysicalKey : std::uint8_t { Unknown = 0, Printable = 1, ArrowLeft = 2, ArrowRight = 3, ArrowUp = 4, ArrowDown = 5, Backspace = 6, Delete = 7, Enter = 8, Escape = 9, Tab = 10 };
constexpr bool valid_PhysicalKey(std::uint8_t value) noexcept {
    switch (value) {
    case 0:
    case 1:
    case 2:
    case 3:
    case 4:
    case 5:
    case 6:
    case 7:
    case 8:
    case 9:
    case 10:
        return true;
    default: return false;
    }
}
enum class RouteTarget : std::uint8_t { Unknown = 0, IME = 1, CandidateView = 2, Editor = 3, Literal = 4, Find = 5, System = 6 };
constexpr bool valid_RouteTarget(std::uint8_t value) noexcept {
    switch (value) {
    case 0:
    case 1:
    case 2:
    case 3:
    case 4:
    case 5:
    case 6:
        return true;
    default: return false;
    }
}
enum class SemanticAction : std::uint8_t { Unknown = 0, Compose = 1, CandidateSelection = 2, CandidateNavigation = 3, MoveCaret = 4, CompositionBackspace = 5, DocumentBackspace = 6, DocumentDelete = 7, ReopenMember = 8, InsertNewline = 9, DirectInsert = 10, Cancel = 11 };
constexpr bool valid_SemanticAction(std::uint8_t value) noexcept {
    switch (value) {
    case 0:
    case 1:
    case 2:
    case 3:
    case 4:
    case 5:
    case 6:
    case 7:
    case 8:
    case 9:
    case 10:
    case 11:
        return true;
    default: return false;
    }
}
enum class RevisionCause : std::uint8_t { Unknown = 0, Input = 1, Selection = 2, CompositionBackspace = 3, ReopenMember = 4 };
constexpr bool valid_RevisionCause(std::uint8_t value) noexcept {
    switch (value) {
    case 0:
    case 1:
    case 2:
    case 3:
    case 4:
        return true;
    default: return false;
    }
}
enum class CompositionOutcome : std::uint8_t { Unknown = 0, Completed = 1, Cancelled = 2, AbandonedByContextChange = 3, Error = 4 };
constexpr bool valid_CompositionOutcome(std::uint8_t value) noexcept {
    switch (value) {
    case 0:
    case 1:
    case 2:
    case 3:
    case 4:
        return true;
    default: return false;
    }
}
enum class CompletionState : std::uint8_t { Unknown = 0, Partial = 1, Complete = 2 };
constexpr bool valid_CompletionState(std::uint8_t value) noexcept {
    switch (value) {
    case 0:
    case 1:
    case 2:
        return true;
    default: return false;
    }
}
enum class SelectionOutcome : std::uint8_t { Other = 0, Accepted = 1, RejectedStale = 2, RejectedInvalid = 3, NoMatch = 4, Cancelled = 5 };
constexpr bool valid_SelectionOutcome(std::uint8_t value) noexcept {
    switch (value) {
    case 0:
    case 1:
    case 2:
    case 3:
    case 4:
    case 5:
        return true;
    default: return false;
    }
}
enum class SpatialDirection : std::uint8_t { None = 0, Left = 1, Right = 2, Up = 3, Down = 4 };
constexpr bool valid_SpatialDirection(std::uint8_t value) noexcept {
    switch (value) {
    case 0:
    case 1:
    case 2:
    case 3:
    case 4:
        return true;
    default: return false;
    }
}
enum class MutationType : std::uint8_t { Unknown = 0, Insert = 1, Remove = 2, Replace = 3 };
constexpr bool valid_MutationType(std::uint8_t value) noexcept {
    switch (value) {
    case 0:
    case 1:
    case 2:
    case 3:
        return true;
    default: return false;
    }
}
enum class OperationOutcome : std::uint8_t { Unknown = 0, Succeeded = 1, Failed = 2, Cancelled = 3 };
constexpr bool valid_OperationOutcome(std::uint8_t value) noexcept {
    switch (value) {
    case 0:
    case 1:
    case 2:
    case 3:
        return true;
    default: return false;
    }
}
enum class FileOperation : std::uint8_t { Unknown = 0, Save = 1, Open = 2, Close = 3, Autosave = 4, New = 5, Reload = 6, Other = 7 };
constexpr bool valid_FileOperation(std::uint8_t value) noexcept {
    switch (value) {
    case 0:
    case 1:
    case 2:
    case 3:
    case 4:
    case 5:
    case 6:
    case 7:
        return true;
    default: return false;
    }
}
enum class InputScheme : std::uint8_t { Unknown = 0, FullPinyin = 1, XiaoheShuangpin = 2, English = 3 };
constexpr bool valid_InputScheme(std::uint8_t value) noexcept {
    switch (value) {
    case 0:
    case 1:
    case 2:
    case 3:
        return true;
    default: return false;
    }
}
enum class NavigationOutcome : std::uint8_t { Unknown = 0, Moved = 1, BoundaryHit = 2, NoCandidates = 3, RejectedStale = 4, Other = 5 };
constexpr bool valid_NavigationOutcome(std::uint8_t value) noexcept {
    switch (value) {
    case 0:
    case 1:
    case 2:
    case 3:
    case 4:
    case 5:
        return true;
    default: return false;
    }
}
enum class ViewReason : std::uint8_t { Unknown = 0, CompositionUpdate = 1, CandidateUpdate = 2, DocumentEdit = 3, CursorMove = 4, SelectionChange = 5, ViewportMove = 6, ModeChange = 7, Other = 8 };
constexpr bool valid_ViewReason(std::uint8_t value) noexcept {
    switch (value) {
    case 0:
    case 1:
    case 2:
    case 3:
    case 4:
    case 5:
    case 6:
    case 7:
    case 8:
        return true;
    default: return false;
    }
}
enum class OutputCountUnit : std::uint8_t { Unknown = 0, UnicodeScalar = 1, GraphemeCluster = 2, ProductUnit = 3 };
constexpr bool valid_OutputCountUnit(std::uint8_t value) noexcept {
    switch (value) {
    case 0:
    case 1:
    case 2:
    case 3:
        return true;
    default: return false;
    }
}
enum class ToggleState : std::uint8_t { Unknown = 0, Off = 1, On = 2 };
constexpr bool valid_ToggleState(std::uint8_t value) noexcept {
    switch (value) {
    case 0:
    case 1:
    case 2:
        return true;
    default: return false;
    }
}
enum class LearningMode : std::uint8_t { Unknown = 0, Disabled = 1, ObserveOnly = 2, Enabled = 3 };
constexpr bool valid_LearningMode(std::uint8_t value) noexcept {
    switch (value) {
    case 0:
    case 1:
    case 2:
    case 3:
        return true;
    default: return false;
    }
}
enum class IdentityScope : std::uint8_t { Unknown = 0, Synthetic = 1, Product = 2 };
constexpr bool valid_IdentityScope(std::uint8_t value) noexcept {
    switch (value) {
    case 0:
    case 1:
    case 2:
        return true;
    default: return false;
    }
}
enum class Boolean : std::uint8_t { False = 0, True = 1 };
constexpr bool valid_Boolean(std::uint8_t value) noexcept {
    switch (value) {
    case 0:
    case 1:
        return true;
    default: return false;
    }
}
enum class EventType : std::uint16_t {
    SessionStart = 1,
    StateSnapshot = 2,
    StateChange = 3,
    SyncSnapshot = 4,
    TelemetryHealth = 5,
    InputReceived = 6,
    RouteDecision = 7,
    CompositionBegin = 8,
    CompositionRevision = 9,
    CompositionEnd = 10,
    ImePlanBegin = 11,
    ImeRangeReady = 12,
    CandidateDataReady = 13,
    CandidateNavigation = 14,
    SelectionRequest = 15,
    SelectionResult = 16,
    CandidateItemDetail = 17,
    EditorAction = 18,
    DocumentMutation = 19,
    ViewReady = 20,
    DisplaySubmit = 21,
    DisplayAck = 22,
    FileOpBegin = 23,
    FileOpEnd = 24,
    RuntimeIdentity = 25,
};
constexpr bool is_known_event_type(EventType type) noexcept {
    switch (type) {
    case EventType::SessionStart:
    case EventType::StateSnapshot:
    case EventType::StateChange:
    case EventType::SyncSnapshot:
    case EventType::TelemetryHealth:
    case EventType::InputReceived:
    case EventType::RouteDecision:
    case EventType::CompositionBegin:
    case EventType::CompositionRevision:
    case EventType::CompositionEnd:
    case EventType::ImePlanBegin:
    case EventType::ImeRangeReady:
    case EventType::CandidateDataReady:
    case EventType::CandidateNavigation:
    case EventType::SelectionRequest:
    case EventType::SelectionResult:
    case EventType::CandidateItemDetail:
    case EventType::EditorAction:
    case EventType::DocumentMutation:
    case EventType::ViewReady:
    case EventType::DisplaySubmit:
    case EventType::DisplayAck:
    case EventType::FileOpBegin:
    case EventType::FileOpEnd:
    case EventType::RuntimeIdentity:
        return true;
    default: return false;
    }
}
struct SessionStartEvent {
    std::uint8_t writing_mode;
    std::uint8_t base_input_mode;
    std::uint8_t input_scheme;
    std::uint8_t edit_context;
    std::uint32_t raw_length;
    std::uint32_t focus;
    std::uint32_t selected_member_count;
    std::uint8_t candidate_valid;
};
struct StateSnapshotEvent {
    std::uint8_t writing_mode;
    std::uint8_t base_input_mode;
    std::uint8_t input_scheme;
    std::uint8_t edit_context;
    std::uint32_t raw_length;
    std::uint32_t focus;
    std::uint32_t selected_member_count;
    std::uint8_t candidate_valid;
};
struct StateChangeEvent {
    std::uint8_t writing_mode;
    std::uint8_t base_input_mode;
    std::uint8_t input_scheme;
    std::uint8_t edit_context;
    std::uint32_t raw_length;
    std::uint32_t focus;
    std::uint32_t selected_member_count;
    std::uint8_t candidate_valid;
};
struct SyncSnapshotEvent {
    std::uint8_t writing_mode;
    std::uint8_t base_input_mode;
    std::uint8_t input_scheme;
    std::uint8_t edit_context;
    std::uint32_t raw_length;
    std::uint32_t focus;
    std::uint32_t selected_member_count;
    std::uint8_t candidate_valid;
};
struct TelemetryHealthEvent {
    std::uint64_t attempted;
    std::uint64_t enqueued;
    std::uint64_t dropped_queue;
    std::uint64_t dropped_invalid;
    std::uint64_t sink_busy;
    std::uint64_t dropped_sink_failed;
    std::uint64_t dropped_encode;
    std::uint64_t transport_failures;
    std::uint32_t queue_high_water;
    std::uint64_t frames_accepted;
    std::uint64_t bytes_accepted;
};
struct InputReceivedEvent {
    std::uint8_t physical_key;
    std::uint8_t modifiers;
};
struct RouteDecisionEvent {
    std::uint8_t route_target;
    std::uint8_t semantic_action;
};
struct CompositionBeginEvent {
    std::uint32_t raw_length;
    std::uint32_t focus;
    std::uint32_t selected_member_count;
    std::uint8_t cause;
};
struct CompositionRevisionEvent {
    std::uint32_t raw_length;
    std::uint32_t focus;
    std::uint32_t selected_member_count;
    std::uint8_t cause;
};
struct CompositionEndEvent {
    std::uint8_t outcome;
};
struct ImePlanBeginEvent {
    std::uint32_t work_id;
    std::uint32_t range_start;
    std::uint32_t range_end;
};
struct ImeRangeReadyEvent {
    std::uint32_t work_id;
    std::uint32_t range_start;
    std::uint32_t range_end;
};
struct CandidateDataReadyEvent {
    std::uint32_t work_id;
    std::uint32_t range_start;
    std::uint32_t range_end;
    std::uint32_t candidate_count_known;
    std::uint32_t visible_start;
    std::uint32_t visible_count;
    std::uint8_t completion_state;
};
struct CandidateNavigationEvent {
    std::uint32_t previous_index;
    std::uint32_t global_index;
    std::uint32_t window_start;
    std::uint32_t window_count;
    std::uint8_t spatial_direction;
    std::uint8_t outcome;
};
struct SelectionRequestEvent {
    std::uint32_t selection_id;
    std::uint32_t global_index;
    std::uint32_t rank;
};
struct SelectionResultEvent {
    std::uint32_t selection_id;
    std::uint8_t outcome;
    std::uint32_t consumed_start;
    std::uint32_t consumed_end;
    std::uint32_t new_focus;
    std::uint32_t new_composition_revision;
    std::uint32_t confirmed_output_count;
    std::uint8_t output_count_unit;
};
struct CandidateItemDetailEvent {
    std::uint32_t global_index;
    std::uint32_t rank;
    std::uint8_t provenance;
};
struct EditorActionEvent {
    std::uint8_t semantic_action;
    std::uint8_t spatial_direction;
    std::uint32_t cursor_before;
    std::uint32_t cursor_after;
};
struct DocumentMutationEvent {
    std::uint32_t revision_before;
    std::uint32_t revision_after;
    std::uint8_t mutation_type;
    std::uint32_t byte_start;
    std::uint32_t byte_end;
    std::uint32_t inserted_bytes;
    std::uint32_t removed_bytes;
    std::uint32_t cursor_before;
    std::uint32_t cursor_after;
};
struct ViewReadyEvent {
    std::uint8_t writing_mode;
    std::uint8_t reason;
};
struct DisplaySubmitEvent {
    std::uint32_t display_id;
};
struct DisplayAckEvent {
    std::uint32_t display_id;
    std::uint8_t outcome;
};
struct FileOpBeginEvent {
    std::uint32_t file_operation_id;
    std::uint8_t operation;
};
struct FileOpEndEvent {
    std::uint32_t file_operation_id;
    std::uint8_t operation;
    std::uint8_t outcome;
    std::uint32_t byte_count;
};
struct RuntimeIdentityEvent {
    std::uint32_t identity_namespace;
    std::uint32_t firmware_build_id;
    std::uint32_t core_api_family_id;
    std::uint32_t input_host_family_id;
    std::uint32_t resource_generation;
    std::uint32_t rule_policy_generation;
    std::uint32_t runtime_config_id;
    std::uint8_t identity_scope;
    std::uint8_t p2;
    std::uint8_t p3;
    std::uint32_t prefix_slots;
    std::uint32_t tf_frequency_hz;
    std::uint32_t profile_id;
    std::uint32_t locate;
    std::uint8_t prefetch;
    std::uint8_t learning_mode;
};
union EventPayload {
    SessionStartEvent session_start;
    StateSnapshotEvent state_snapshot;
    StateChangeEvent state_change;
    SyncSnapshotEvent sync_snapshot;
    TelemetryHealthEvent telemetry_health;
    InputReceivedEvent input_received;
    RouteDecisionEvent route_decision;
    CompositionBeginEvent composition_begin;
    CompositionRevisionEvent composition_revision;
    CompositionEndEvent composition_end;
    ImePlanBeginEvent ime_plan_begin;
    ImeRangeReadyEvent ime_range_ready;
    CandidateDataReadyEvent candidate_data_ready;
    CandidateNavigationEvent candidate_navigation;
    SelectionRequestEvent selection_request;
    SelectionResultEvent selection_result;
    CandidateItemDetailEvent candidate_item_detail;
    EditorActionEvent editor_action;
    DocumentMutationEvent document_mutation;
    ViewReadyEvent view_ready;
    DisplaySubmitEvent display_submit;
    DisplayAckEvent display_ack;
    FileOpBeginEvent file_op_begin;
    FileOpEndEvent file_op_end;
    RuntimeIdentityEvent runtime_identity;
};
} // namespace draftor::telemetry
